cstartup.obj main.obj exec.obj executil.obj execsubs.obj irq.obj 
util.obj dsp_proc.obj display.obj exec_asm.obj l09.obj sys_mon.obj
sequence.obj async.obj cpuproc.obj

-Z(CODE)CSTART,FLIST,RCODE,CODE,CDATA,ZVECT,CONST,CSTR,CCSTR=4000-FFFF

-Z(CODE)INTVEC=FFD6

-Z(DATA)STACK#1040-1FFF

-Z(DATA)DATA,IDATA,UDATA,ECSTR,WCSTR,TEMP=01C0-0FFF,0000-00FF

-bBCODE=2000,2000,4000

-C cl6811b
