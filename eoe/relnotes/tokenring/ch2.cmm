.nr H1 1
.H 1 "Installation Information"
.\"
.\"	Developer
.\"
This chapter lists supplemental information to 
the \f2IRIS Software Installation Guide.\f1
The information listed here is product- and release-specific;
use it with the Installation Guide to install 
the Token Ring product.
.H 2 "General Information on Installation"
This section contains information that is useful during
the installation procedure.
.P
.rs
.sp .05in
.H 3 "Installation Procedure Overview"
.br
The IRIS Token Ring product consists of a hardware component 
and a software component. 
The hardware component is a Token Ring board; the software
is on the CD-ROM.
To install the product, you must follow the procedures 
in the overview below. The procedures must be followed in the
order they are listed.
.AL
.LI
Install the software, using the instructions in this document in
Section 2.2, ``Installing IRIS Token Ring Software.''
.LI
If your site uses locally assigned physical (MAC) addresses, follow the
instructions in the section ``Configuring the Board's Physical Address''
in Chapter 2 of the \f2IRIS Token Ring Administration Guide\f1.
.LI
Configure the software, using the instructions in Section 2.3,
``Configuring Network Interfaces.''
.LI
Power down the system and install the board, using the appropriate
installation guide or instructions for your hardware platform. The
installation manuals are the \f2Token Ring for IRIS Indigo Installation
Guide\f1, the \f2Token Ring for Indy Installation Guide\f1, and 
the \f2Token Ring Controller Board Installation Instructions\f1
(for VMEbus systems). On the multi-VME-slot platforms, pay special attention 
to the instructions on backplane jumpering if you leave empty lower
slots or if you have boards using DMA in higher-numbered slots.
All the token ring boards are shipped configured 
to run on 16 Mbps rings. If your Token Ring local area network operates
at 4 Mbps, read section 2.5 ``About IRIS Token Ring and 4 Mbps Rings''
of these Notes.
.LI
Verify the Token Ring connection, using the instructions in the section
``Verifying the Network Connection,'' in Chapter 2 of the
\f2IRIS Token Ring Administration Guide\f1.
.LE
.rs
.sp
.ns
.H 3 "IRIS Token Ring Network Interface Names"
.br
Each Token Ring network interface (board and driver)
on an IRIS has a unique name as
listed below:
.rs
.sp
.ta .5i 1i
\f2gtr0\f1	GIO bus Token Ring board in an IRIS Indigo or Indy.
.sp +.03i
\f2fv0\f1	First  IRIS Token Ring board found in a VMEbus slot.
.sp +.03i
\f2fv1\f1	Second IRIS Token Ring board found in a VMEbus slot.
.sp +.03i
\f2fv2\f1	Third  IRIS Token Ring board found in a VMEbus slot.
.sp +.03i
\f2fv3\f1	Fourth IRIS Token Ring board found in a VMEbus slot.
.H 3 "IRIS Token Ring Subsystems"
.br
.\"
.\" Each subsystem should be described in enough detail so that
.\" users can decide whether or not they need to install it.
.\" Hints such as "You need to install this subsystem if you want to use
.\" Visual System Administration Tools" or "This subsystem is useful only
.\" if you want to display Kanji characters" would be nice. For subsystems
.\" such as eoe2.sw.4Dwm that are important if you have graphics, but not 
.\" important for servers and aren't marked required in the spec file (inst 
.\" doesn't show + and doesn't require their installation), be sure to make
.\" this very clear in the description or in a separate list.
.\"
IRIS Token Ring includes the following subsystems:
.VL 30
.LI "\f2tokenring.sw.tokenring\f1"
IRIS Token Ring software for all platforms. 
.LI "\f2tokenring.man.tokenring\f1"
IRIS Token Ring manual pages
.LI "\f2tokenring.man.relnotes\f1"
These IRIS Token Ring release notes
.LE
.rs
.sp 2
.ns
.H 3 "IRIS Token Ring Subsystem Disk Space Requirements"
.br
.\"
.\" The size of each subsystem should be listed so that users get an idea
.\" of the disk space requirements before they get into inst.
.\"
This section lists the IRIS Token Ring subsystems and their sizes.
.P
If you are installing this product for the first time,
the subsystems marked ``default'' are the 
ones that are installed if you use the ``go'' menu item.
To install a different set of subsystems, use 
the ``install,'' ``remove,'' ``keep,'' and ``step'' commands 
in \f2inst\f1 to customize the list of subsystems to be
installed, then select the ``go'' menu item.
.VL 7
.LI "\f6Note:\f1"
The listed subsystem sizes are approximate. 
Refer to the 
\f2IRIS Software Installation Guide\f1
for information on finding exact sizes.
.LE
.ps 9
.vs 11
.TS
tab(:);
lw(1.75i):lw(1.5i)
lw(1.75i):lw(1.5i)
lIw(1.75i):nw(1.5i).
\f6Subsystem Name:Subsystem Size
:\f6(512-byte blocks)\f1
.ps 10
.vs 12
.sp 0.3
tokenring.sw.tokenring \f1(default):1767
.sp 0.3
tokenring.man.relnotes \f1(default):41
.sp 0.3
tokenring.man.tokenring \f1(default):9
.TE
.ps 11
.rs
.sp
.ns
.H 3 "Installation Method"
.br
.\"
.\" The installation methods are called "miniroot installation" and 
.\" "IRIX installation". The specific subsystems that require Miniroot
.\" Installation should be listed, or state that the product can be 
.\" installed with IRIX Installation.
.\"
.\" If some subsystems of this option must be installed using the miniroot
.\" and others can be installed using IRIX, fill in the table below:
.\"
.\"
.\" If all subsystems of this option can be installed using using IRIX, 
.\" include the following paragraph. Be sure to delete the comment
.\" marks at the beginning of each line so the paragraph will print.
.\"
All of the subsystems for IRIS Token Ring can be installed using IRIX.
You do not need to use the miniroot. Refer to the \f2IRIS Software 
Installation Guide\f1 for complete information about the two
installation methods.
.VL 7
.LI "\f6Note: \f1"
Once installed, the IRIS Token Ring driver does not function until 
the following three additional steps have been performed:
(1) the IRIS Token Ring board is installed and connected to
a 802.5 Token Ring local area network, (2) the operating
system is rebuilt (to include the new driver),
and (3) the system is rebooted (to start using the rebuilt
operating system).
.LE
.rs
.H 3 "Prerequisites"
.br
Your IRIS must be running IRIX release 5.3.
To verify the release your system is currently running, use
the command below:
.rs
.sp +.03in
\f8\s-1% \f8versions eoe1\s+1\f1
.sp .03in
.fp 4 HD
.H 2 "Installing IRIS Token Ring Software"
Use the IRIX installation method to 
install the IRIS Token Ring software.
Step-by-step instructions are provided below.
.rs
.VL 7
.LI "\f6Note:\f1"
More detailed explanations about the IRIX installation method
are located 
in the \f2IRIS Software Installation Guide\f1. 
.LE 
.\" end of note
.AL
.LI
In a shell window, become superuser:
.sp +.04in
\s-1\f7% \f8su
.br
\f7Password: \f2thepassword\f1
.br
\f7#\f1\s+1
.LI
Invoke the \f2inst\f1 utility with the command below:
.sp +.04in
\s-1\f7# \f8inst\f1
.br
 \f7{the \f2inst\f1 menu appears}
.br
\f7Inst> \f1\s+1
.LI
When the \f2inst\f1 prompt appears (\f7Inst>\f1), use the \f7\s-1from \s+1\f1command
to indicate the location of IRIS Token Ring software.
.P
The command below can be used when 
the location is a local CD-ROM:
.sp +.04in
\s-1\f7Inst> \f8from /CDROM/dist\f1\s+1
.LI 
When you are ready to install IRIS Token Ring, 
use the command below to select Token Ring software
for installation:
.sp +.04in
\s-1\f7Inst> \f8install tokenring\f1\s+1
.LI
Then use the command below to install the software:
.sp +.04in
\s-1\f7Inst> \f8go\f1\s+1
.LI
When the installation completes successfully, quit:
.sp +.04in
\s-1\f7Inst> \f8quit\f1\s+1
.LI
Follow the steps in the next section, 
``Configuring Network Interfaces.''
.LE
.rs
.sp
.ns
.H 2 "Configuring Network Interfaces"
This section provides step-by-step instructions for configuring the network 
interfaces with a basic configuration that fits
the needs of most sites.
If your site has special configuration requirements
or if your system has a configuration of network interfaces
that is not covered in this section of the release notes, 
refer to the \f2IRIS Token Ring Administration Guide\f1 
and the \f2IRIX Advanced Site and Server Administration Guide\f1 
for more details. 
.P
It is highly recommended that the network interface
be configured before 
installing the IRIS Token Ring board. 
.P
This section is divided into three configuration scenarios.
Select the one that is appropriate.
.BL
.LI
Ethernet as the primary network interface and Token Ring as secondary.
.LI
Token Ring as the primary network interface and Ethernet as secondary.
.LI
Token Ring as the only network interface.
.LE
.rs
.sp +.01in
.VL 7
.LI "\f6Note:\f1"
The procedures described in the following sections configure basic
nonpersonalized network connections. 
If you need or want to configure site-specific items, follow
the instructions in the
\f2IRIX Advanced Site and Server Administration Guide\f1, 
either now (instead of the
instructions provided here) or after 
you have used the instructions here to get the system up and running.
.LE 
.rs
.sp
.ns
.H 3 "Configuring Ethernet as the Primary Interface and Token Ring as Secondary"
.br
This section provides instructions to set up your system 
with two network connections,
where Ethernet is the primary network interface 
and Token Ring is the secondary one.
.VL 10
.LI "\f6Caution:\f1"
If your site uses an NIS service, the changes to the 
\f2/etc/hosts\f1 file described in this section must
\f2also\f1 be made to the hosts database on the NIS server.
.LE
.P
.VL 7
.LI "\f6Note:\f1"
The instructions in this section assume that the system
already has (or has had) a functional Ethernet connection.
If this is not the case, follow the instructions in the 
\f2Personal System Administration Guide\f1 or the 
\f2IRIX Advanced Site and Server Administration Guide\f1 to configure
the system for networking (giving it a host name, IP address,
etc.).
.LE
.AL
.LI
If you are not superuser, 
type \f8\s-1su\s+1\f1 to become superuser (\f2root\f1):
.sp +.04in
\s-1\f7% \f8su\f1
.br
\f7Password: \f2thepassword\f1
.br
\f7#\f1\s+1
.LI
Determine your station's host name:
.sp +.04in
\s-1\f7# \f8hostname\f1\s+1
.VL 7
.LI "\f6Note:\f1"
If the host name is IRIS,
the station's built-in Ethernet connection is not currently
configured. Follow the instructions in the \f2Personal System
Administration Guide\f1 to configure your system as a networked station.
.LE
.LI
Verify that the system has been configured
as a networked station for Ethernet using the command line below:
.sp +.04in
\f7\s-1% \f8/usr/etc/netstat -i\s+1\f1
.sp
If the display lists \f2ec0\f1, \f2fxp0\f1, \f2et0\f1, \f2enp0\f1
or another Ethernet network interface name, and if there is an
entry other than ``none'' in the \f7Address\f1 column, proceed.
If no Ethernet interface is listed or if the address 
is listed as ``\f7none\f1,'' follow the instructions in the
\f2Personal System Administration Guide\f1 to connect your
system to an Ethernet network. 
Do not proceed until the station has
one functioning Ethernet connection.
.LI
Use your favorite editor to open the \f2/etc/hosts\f1 file.
To open the file with \f2jot\f1, use the line below:
.sp +.04in
\s-1\f7# \f8/usr/sbin/jot /etc/hosts\s+1\f1 
.LI
Find the line with your station's host name and copy it.
.LI
Paste the copy below the original.
.LI
On the new line, change the address (digits on the left)
to the station's IP address for the Token Ring network. 
.VL 7
.LI "\f6Note: \f1
IP addresses are usually assigned by a site's network
administrator (who obtained the addresses from the
Network Information Center). For further information, see the
section on choosing an IP address in the 
\f2IRIX Advanced Site and Server Administration Guide\f1.
.LE
.LI
Also on the new line, change each instance of your station's \f2hostname\f1 
to tr-\f2hostname\f1.
.P
For example, if you were creating entries for a station with
a host name of \f2mickey\f1 residing in the domain \f2disney.com\f1, 
you would now have the following
two lines in the \f2/etc/hosts\f1 file, where each x can be one
to three digits:
.nf
.ta .7in 1.0in 4.25in
.P
\f7\s-2x.x.x.x	mickey.disney.com mickey	#Ether, primary
x.x.x.x	tr-mickey.disney.com tr-mickey	#TknRng, secondary\s+2\f1
.fi
.LI
Do not edit the original line.
.LI
Save and close the file.
.LI
You are now ready to install the IRIS Token Ring board. Follow
the instructions in the appropriate guide for your system.
When you power on the system after installation, rebuild the
operating system by answering \f8\s-1yes \f1\s+1when prompted, then restart 
the system a second time.
.VL 7
.LI "\f6Note:\f1"
If the board is already installed, restart the system, rebuild the
operating system by answering \f8\s-1yes \f1\s+1when prompted, then restart 
the system a second time.
.LE
.rs
.sp 
.ns
.H 3 "Configuring Token Ring as Primary Network Interface and Ethernet as Secondary"
.br
This section provides instructions to set up your system 
for two network connections,
with Token Ring as the primary network interface and
Ethernet as the secondary one.
.VL 10
.LI "\f6Caution:\f1"
If your site uses an NIS service, the changes to the 
\f2/etc/hosts\f1 file described in this section must
\f2also\f1 be made to the hosts database on the NIS server.
.LE
.P
.VL 7
.LI "\f6Note:\f1"
The instructions in this section assume that the system
already has (or has had) a functional Ethernet connection.
If this is not the case, follow the instructions in the 
\f2Personal System Administration Guide\f1 or the 
\f2IRIX Advanced Site and Server Administration Guide\f1 to configure
the system for networking (giving it a host name, IP address,
etc.).
.LE
.AL
.LI
If you are not superuser, 
type \f8\s-1su\s+1\f1 to become superuser (\f2root\f1):
.sp +.04in
\s-1\f7% \f8su\f1
.br
\f7Password: \f2thepassword\f1
.br
\f7#\f1\s+1
.LI
Determine your station's host name:
.sp +.04in
\s-1\f7# \f8hostname\f1\s+1
.VL 7
.LI "\f6Note:\f1"
If the host name is IRIS,
the station's built-in Ethernet connection is not currently
configured. Follow the instructions in the \f2Personal System
Administration Guide\f1 to configure your system as a networked station.
.LE
.LI
Verify that the system has been configured
as a networked station for Ethernet using the command line below:
.sp
\f7\s-1% \f8/usr/etc/netstat -i\s+1\f1
.sp
If the display lists \f2ec0\f1, \f2fxp0\f1, \f2et0\f1, \f2enp0\f1
or another Ethernet network interface name, and if there is an
entry other than ``none'' in the \f7Address\f1 column, proceed.
If no Ethernet interface is listed or if the address
is listed as ``\f7none\f1'', follow the instructions in the
\f2Personal System Administration Guide\f1 to connect the 
system to an Ethernet network. Do not proceed until your station has
one functioning Ethernet connection.
.LI
Use your favorite editor to open the \f2/etc/hosts\f1 file.
To open the file with \f2jot\f1, use the line below:
.sp +.04in 
\s-1\f7# \f8/usr/sbin/jot /etc/hosts\s+1\f1 
.LI
Find the line with your station's host name and copy it. 
.LI
Paste the copy below the original.
.LI
Return to the original line. Change the address (digits on the left)
to the IP address for the Token Ring network. 
This line configures your station's Token Ring 
network interface.
.VL 7
.LI "\f6Note:\f1"
IP addresses are usually assigned by a site's
network administrator (who has obtained the addresses from
the Network Information Center). The network portion of the
IP address for each local area network must be unique;
you cannot use the same network address for your system's
Ethernet and Token Ring connections. For further information, see the
section on choosing an IP address in the
\f2IRIX Advanced Site and Server Administration Guide\f1.
.LE
.LI
Go to the new line. Change each instance of your station's \f2hostname\f1 
to gate-\f2hostname\f1.
This line configures your station's Ethernet network interface.
Do not change the IP address on the new line (representing the
Ethernet connection.)
.P
For example, if you were creating entries for a station with
a host name of \f2mickey\f1 residing in the domain \f2disney.com\f1, 
you would now have the following
two lines in the \f2/etc/hosts\f1 file, where each x can be one
to three digits:
.nf
.ta .7in 1.0in 4.5in
.P
\f7\s-2x.x.x.x	mickey.disney.com mickey	#TkRng primary
x.x.x.x	gate-mickey.disney.com gate-mickey	#Ether secondary\s+2\f1
.fi
.LI
Save and close the file.
.LI
Edit the \f2/etc/config/netif.options\f1 file.
To open the file with \f2jot\f1, use the command line below:
.sp +.04in
\s-1\f7# \f8/usr/sbin/jot /etc/config/netif.options\s+1\f1 
.LI
Find the line below:
.sp +.04in
\f7\s-1: if1name=\s+1\f1
.LI
Change the line to one of the following. 
Notice that the colon and leading space must be removed.
.sp +.04in
\f8\s-1if1name=gtr0\s+1\f1
.br
or
.br
\f8\s-1if1name=fv0\s+1\f1
.VL 7
.LI "\f6Note:\f1"
Be sure to use the correct network interface name,
as described in Section 2.1.2, ``IRIS Token Ring Network Interface
Names.''
.LE
.LI
Find the line below:
.sp +.04in
\f7\s-1: if2name=\s+1\f1
.LI
Edit the line to match one of the following.
Notice that the colon and leading space must be removed.
.sp +.04in
\f8\s-1if2name=ec0\s+1\f1
.br
or
.br
\f8\s-1if2name=\f2Ethernetinterfacename\s+1\f1
.LI
Verify that the following two lines exist and match:
.sp +.04in
\f7\s-1if1addr=$HOSTNAME
.br
\f7if2addr=gate-$HOSTNAME\f1\s+1
.sp
If the lines do not exist or do not match, edit them so that
they do.
.LI
Save and close the file.
.LI
You are now ready to install the IRIS Token Ring board. Follow
the instructions in the appropriate guide for your system.
When you power on the system after installation, rebuild the
operating system by answering \f8\s-1yes \f1\s+1when prompted, then restart 
the system a second time.
.VL 7
.LI "\f6Note:\f1"
If the board is already installed, restart the system, rebuild the
operating system by answering \f8\s-1yes \f1\s+1when prompted, then restart 
the system a second time.
.LE
.rs
.sp
.ns
.H 3 "Configuring Token Ring as the Only Network Interface"
.br
This section provides instructions to set up your system with one
network connection, a
Token Ring connection.
.AL
.LI
If you are not superuser, use the command below to 
become superuser (\f2root\f1).
.sp +.04in
\s-1\f7% \f8su
.br
\f7Password: \f2thepassword\f1
.br
\f7#\s+1\f1
.LI
Determine your station's host name, using the command below:
.sp +.04in
\s-1\f7# \f8hostname\f1\s+1
.VL 7
.LI "\f6Note:\f1"
If the host name is IRIS,
the station has not been configured for networking. 
Follow the instructions in the \f2Personal System
Administration Guide\f1 to configure your system as a networked station.
.LE
.LI
Use your favorite editor to open the \f2/etc/hosts\f1 file.
To open the file with \f2jot\f1, use the command below:
.sp +.04in
\s-1\f7# \f8/usr/sbin/jot /etc/hosts\f1\s+1
.LI
Find the line with your station's host name. 
.LI
Change the address (digits on the left)
to the IP address for the Token Ring network.
.P
For example, if you were making an entry for a station with
a host name of \f2mickey\f1 residing in the domain \f2disney.com\f1
with a Token Ring IP address of 223.8.27.6, 
you would create the following
line in the \f2/etc/hosts\f1 file:
.nf
.ta .7in 1.3in 4.0in
.P
\f7\s-1223.8.27.6	mickey.disney.com mickey	#TokRng\s+1\f1
.fi
.LI
Save and close the file.
.LI
Open the \f2/etc/config/netif.options\f1 file.
To open the file with \f2jot\f1, use the command line below:
.sp +.04in
\s-1\f7# \f8/usr/sbin/jot /etc/config/netif.options\s+1\f1 
.LI
Find the line below:
.sp +.04in
\f7\s-1: if1name=\s+1\f1
.LI
Change the line to one of the following. 
Notice that the colon and leading space must be removed.
.sp +.04in
\f8\s-1if1name=gtr0\s+1\f1
.br
or
.br
\f8\s-1if1name=fv0\s+1\f1
.VL 7
.LI "\f6Note:\f1"
Be sure to use the correct network interface name,
as described in Section 2.1.2, ``IRIS Token Ring Network Interface
Names.''
.LE
.LI
Verify that the line containing the word \f7if1addr\f1
matches the line  below:
.sp +.04in
\f7\s-1: if1addr=$HOSTNAME\s+1\f1
.LI
Now define the number of network interfaces as 1. This step is
important if you have any other network interfaces physically 
present in the system, such as a built-in ethernet controller.
Look for the line containing the word \f7if_num\f1 and
make sure that it says:
.sp +.04in
\f7\s-1if_num=1\s+1\f1
.br
.sp
If this line is not present in the file, create it.
.LI
Save and close the file.
.LI
You are now ready to install the IRIS Token Ring board. Follow
the instructions in the appropriate guide for your system.
When you power on the system after installation, rebuild the
operating system by answering \f8\s-1yes \f1\s+1when prompted, then restart 
the system a second time.
.VL 7
.LI "\f6Note:\f1"
If the board is already installed, restart the system, rebuild the
operating system by answering \f8\s-1yes \f1\s+1when prompted, then restart 
the system a second time.
.LE
.ns
.sp
.rs
.H 2 "About IRIS Token Ring and Diskless Workstations"
.P
A diskless Token Ring station must be configured in accord with the guidelines
in this section.
.AL
.LI
The station must have either two network interfaces
(an Ethernet from which to boot and a Token Ring)
or a local CD-ROM player from which to boot and a Token Ring interface.
The remaining text and guidelines apply only to stations that boot
over an Ethernet.
.P
A diskless workstation (client) must boot (from its server) over
its Ethernet connection,
hence, the diskless station must have both
Ethernet and
Token Ring connections, if it wants to use resources on a Token Ring network.
Use the command below to display the station's network interfaces, then
verify that one of the IP addresses in the display is for an Ethernet and
one is for a Token Ring local area network:
.rs
.sp +.03i
\s-1\f7% \f8/usr/etc/netstat -in
.Ee
.LI
The \f2netaddr\f1 value in NVRAM must be an Ethernet IP address.
.P
The station's PROM must use the  
Ethernet connection
for booting over the network. 
To verify that the system's PROM can access the Ethernet, 
use the commands below.
The values for \f2netaddr\f1 and \f2inet\f1 must match.
.sp +.03i
\s-1\f7% \f8/etc/nvram netaddr
.br
\f2xxx.xxx.xxx.xxx
.br
\f7% \f8/usr/etc/ifconfig \f2Ethernetinterface\f7
.br
 . . .
.br
    inet \f2xxx.xxx.xxx.xxx  . . .\f1
.Ee
.LI
Ethernet must be configured as the primary network interface.
.P
Once the PROM has loaded the miniroot (bootstrap kernel) from the boot server,
control is passed to the miniroot. 
At this point, the diskless client is known to the
boot server by the IP address in the NVRAM. 
If this address were to change at this point,
the server would become confused and the boot process would not complete. 
The best and easiest way to prevent this from happening 
is to configure Ethernet 
(and build the miniroot with Ethernet)
as the primary network interface.
.P
To verify that Ethernet is configured as the primary network interface
and Token Ring is the secondary, use the commands below,
where \f2Ethernetinterface\f1 is \f2ec0\f1, \f2enp0\f1, \f2et0\f1,
or another Ethernet interface and \f2TRinterface\f1 is \f2fv#\f1
or \f2gtr#\f1:
.rs
.sp +.03i
\s-1\f7# \f8/bin/grep if1name /etc/config/netif.options\f1\s+1
.br
.in +.3in
<the display should be \f7if1name=\s-1\f2Ethernetinterface\s+1\f1>
.in -.3in
.br
\s-1\f7# \f8/bin/grep if2name /etc/config/netif.options\f1\s+1
.br
.in +.3in
<the display should be \f7if2name=\s-1\f2TRinterface\s+1\f1>
.in -.3in
.Ee
.LE
.VL 7 
.LI "Note:"
Once the miniroot is in control, the booting procedure is
completed using NFS\(rg over the network interface that the
station's route daemon indicates is the shortest path to the boot server.
If you want booting to complete over the Token Ring network, use a \f2route\f1
command in a configuration file to force the route daemon (\f2routed\f1) 
to believe that the shortest route
to the boot server is over the Token Ring network interface.
See the man pages for \f2routed\f1 and \f2route\f1 for details.
.LE
.rs
.sp +.25in
.ns
.H 2 "About IRIS Token Ring and 4Mbps Rings"
The IRIS Token Ring product is shipped with a configuration
for 16 megabit per second (Mbps) transmission speed. If your
local area network operates at 4Mbps, you will need to change
this configuration.
.br
.sp
If you are installing a VME token ring board, follow the instructions
in the board's installation document for moving the ring speed jumper
before you plug the board into the system.
.br
.sp
If you are installing a GIO board (in an IRIS Indigo or Indy) this
change should be made in software after the board is installed and 
before the board is attached to the ring. To do so, follow the 
instructions above for installing software, configuring addresses 
and installing the board. However when you install the board, do not
attach it to the ring yet. When you power up the system the first time
after installing the board, you will be asked if you want to rebuild 
the system. Reply yes, then reboot to run on the new system. Since
the board is not attached to the ring, it will report an error:
.br
gtr0: OPEN: Lobe media test phase: Function failure.
.br
This is expected. Now log in as root and do the following:
.sp +.03i
\s-1\f7# \f8/usr/etc/trconfig gtr0 -s 4
.br
This will set the board's ring speed to 4 Mbps. Confirm the setting
using the command
.br
\s-1\f7# \f8/usr/etc/trconfig gtr0 -v
.br
Now attach the board to the ring and reboot once again to complete
the installation process.
