.\" Tips for using this release notes chapter:
.\"
.\" o  Use this chapter only if your product uses NetLS licensing.
.\" o  Substitute your product's name everywhere that <<PRODUCT>> appears.
.\" o  Substitute the names of all of the programs in your product that
.\"    use NetLS and their manual page section numbers for <<binary1(1))>>,
.\"    <<binary2(1)>>, and <<binary3(1)>>, for example, netlook(1M).
.\" o  Licensing is handled in different ways for different products.
.\"    Comments in this chapter include substitute paragraphs for some
.\"    of the differences; you should modify this chapter as needed for
.\"    your product.
.nr H1 2
.H 1 "Activating Your Disk Plexing Option License"
Your copy of the Disk Plexing Option
requires a software license in order to operate.
This chapter defines some important software licensing terms,
describes the basic procedure for obtaining, installing, and
testing a software license for the Disk Plexing Option,
and lists addresses and phone numbers that you can use to contact
Silicon Graphics License Administration.
.P
For more information about software licenses, see the
\f2FLEXlm End User Manual\f1,
which provides detailed information on obtaining, installing,
using, and administering software licenses.
It is included in the system software documentation; the online
version is in the subsystem \f2license_eoe.books.FLEXlm_EUM\f1.
.P
\f2Note that the Disk Plexing Options requires that the license be
installed in a non-standard location. This is necessary because 
this software needs to run before the default licensing directories
are available.\f1
.H 2 "A Few Definitions"
A \f2software license\f1 is a collection of information that,
after installation, allows you to use a licensed software
product on one or more systems.
The software license information includes the license type,
the license expiration date, a license password, and system
identification numbers (\f2sysinfo\f1 and serial numbers).
You can get a system's sysinfo number by giving
the command \f8/etc/sysinfo\ -s\f1.
The license must be installed on the system that has the sysinfo
number included in the software license information.
If the sysinfo is ``Any,'' the software license can
be installed on any system.
.P
There are two types of software licenses, \f2node-locked\f1 and
\f2concurrent\f1, and two durations of software licenses,
\f2temporary\f1 and \f2permanent\f1:
.VL 13
.LI node-locked
A node-locked license is installed on a particular system (node)
and allows the licensed software to run on that system.
.LI concurrent
A concurrent license allows the licensed software to run on
one or more systems in the network simultaneously.
The number of systems (nodes) allowed is included
in the software license information.
The system on which a concurrent license is installed must
be configured as a Network License Server.
Any system on the same network must be
configured as a Global Location Broker.
(See the \f2Network License System Administration Guide\f1 for more
information about Network License Servers and Global Location Brokers.)
.LI temporary
A temporary license allows you to use the licensed software
for a short period, typically a week to several months.
The expiration date tells you the last date on
which you can use the licensed software.
Temporary licenses are often shipped with software so that
you can use the software before a permanent license is issued.
.LI permanent
A permanent license allows you to use this release
of the licensed software for a very long time.
For example, an expiration date in the year 2038
indicates a permanent license.
Permanent licenses are issued only for software that has been purchased.
.H 2 "Obtaining and Installing a Software License"
This section explains the procedure for obtaining and installing a
software license:  checking to see if you have
received software license information,
determining if you need to install a license,
requesting software license information if you need it,
identifying the system on which you will install the license,
installing the software license information, and
verifying that the license is working.
.AL
.LI
Check to see if you have received software license information.
.P
Software license information is distributed in several ways:  on labels
attached to a Software License Registration card, on sheets of paper
included with the product, or by mail, FAX, or electronic mail.
.\"  For products that are shipped with two temporary licenses, add this
.\"  paragraph:
.\"
.\"This product is shipped with two licenses, both temporary.
.\"One is a node-locked license and the other is a concurrent license.
.\"You can install either one.
.LI
Determine if you need to install a software license.
.P
You may or may not need to install a software license for
the Disk Plexing Option:
.BL
.LI
.\" If you are simply updating your system to this release of
.\" the Disk Plexing Option,
.\" you may not need to install a new license at this time;
.\" your already-installed license may continue to work.
.\"
.\"  In situations where a new release requires a new license, substitute
.\"  this paragraph (modified as appropriate) for the paragraph above:
.\"
\f2If you are updating to this release of the Disk Plexing Option
from an older release, you must install a new license BEFORE installing
the new software. If the new license is not installed, your system may
not properly restart after the installation.\f1
.LI
If you have received both a temporary license and a
permanent software license, install the permanent license;
do not install the temporary license.
.LI
If you have received a permanent license, you should install it because
it enables you to use the software that you have purchased.
.LI
If concurrent licenses are used at your site and you plan to use an
already-installed license, you can install and use the licensed software
on your system without installing a license.
.LI
If you have received a temporary software license and do not need to use the
software immediately, you may choose to wait to install a license until you
obtain the permanent license.
.LE
.LI
Request a software license if you don't have a software
license at all, or if you have a temporary
license and need a permanent license.
.P
To obtain a software license, fill out the Software License
Registration card that was included with the software (or the
replica in the \f2FLEXlm End User Manual\f1).
Send the information or the card by electronic mail (preferred), FAX, or
mail to Silicon Graphics License Administration or your local service
provider (see the next section for addresses).
After your request is received by Silicon Graphics or your local service
provider, you should receive a software license within two business days.
.LI
Identify the system on which you will install the software license.
.P
Because software license information usually must be installed
on a particular system, follow these guidelines:
.BL
.LI
If the sysinfo is a number, identify the system that returns
that number as the output of the command \f8/etc/sysinfo\ -s\f1.
(It may be easier to identify the system using the serial number,
which is included in the software license information.)
.LI
If the sysinfo is ``Any,'' you can install
the license on any system you choose.
.LI
If the sysinfo number included with the software license information
doesn't match the sysinfo number of the system on which you want to
install the license, contact Silicon Graphics License Administration.
.LE
.LI
Install the software license (temporary or permanent).
.P
The Disk Plexing Option uses a node-locked license.
The license for the Disk Plexing Option must be installed in
.IR /etc/flexlm/license.dat .
This is a nonstandard location.
.P
To install the license, log into the root account and
create or edit the
.I /etc/flexlm/license.dat
file using jot(1G) or your preferred editor. Type:
.P
	\f4jot /etc/flexlm/license.dat\f1
.P
Add the license to the license file. Save the file and exit the editor.
.P
Save the license information sheet; you may need it again later,
if you need to reinstall this license.
.\"  If this product includes its own license installation tool (for
.\"  example nvlicense for NetVisualyzer, mention that tool here.
.LI
Verify that the software license has been successfully installed.
.P
To verify that the software license is working
after software installation, run
.IR xlv_mgr (1m)
and invoke the
.I "show config"
command.
.I xlv_mgr
will display whether or not the Disk Plexing Option is present.
.P
If you installed a temporary license and you are entitled to a
permanent license,
replace the temporary license with a permanent license as soon as possible
to ensure uninterrupted use of the Disk Plexing Option.
.H 2 "Contacting Silicon Graphics License Administration"
In the United States and Canada, Silicon Graphics License Administration
provides software license information to Silicon Graphics customers.
You can contact Silicon Graphics License Administration in these ways:
.VL 15
.LI "Electronic mail:"
license@sgi.com
.LI FAX:
(415) 390-0537
.LI Mail:
Software Licensing M/S 134
.nf
Silicon Graphics, Inc.
P.O. Box 7311
Mountain View, CA 94039-9600
.fi
.LE
In an emergency, you can telephone Silicon Graphics at (800) 800-4744.
.P
If you are not in the United States or Canada, or if you purchased the
system or software from a vendor other than Silicon Graphics, please
contact your local service provider.
