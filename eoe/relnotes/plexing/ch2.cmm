.nr H1 1
.H 1 "Installation Information"
.\"
.\"	Developer
.\"
This chapter lists supplemental information to 
the \f2IRIS Software Installation Guide.\f1
The information listed here is product-specific;
use it with the installation guide to install 
this product.
.H 2 "Disk Plexing Option License"
The IRIX 6.4 software includes a logical volume manager
called XLV. XLV allow you to organize multiple disk drives into
a single logical volume that can be accessed as a disk.  The base
XLV software allows you to concatenate and stripe disks together.
.P
The Disk Plexing Option allows you to plex (or mirror) multiple
disks together for reliability. With the Disk Plexing Option, you 
can create and use volumes that maintain multiple copies of the data.
This allows you to recover from disk failures.
In addition to fault-tolerance, the Disk Plexing Option also 
allows you to perform a wide range of volume reconfigurations online.
The Disk Plexing Option allows you to, for example, replace a 
disk drive that is about to fail with another disk drive; and this
can be done while the logical volume is mounted and actively being
used.
..\"
.\" Each subsystem should be described in enough detail so that
.\" users can decide whether or not they need to install it.
.\" Hints such as "You need to install this subsystem if you want to use
.\" Visual System Administration Tools" or "This subsystem is useful only
.\" if you want to display Kanji characters" would be nice. For subsystems
.\" such as eoe2.sw.4Dwm that are important if you have graphics, but not 
.\" important for servers and aren't marked required in the spec file (inst 
.\" doesn't show + and doesn't require their installation), be sure to make
.\" this very clear in the description or in a separate list.
.\"

.\"
.\" Don't try and fix the problem where NFS_AG appears as "NFS AG".
.\" It's a bug in grelnotes and won't be fixed.
.\"

.\"
.\" The size of each subsystem should be listed so that users get an idea
.\" of the disk space requirements before they get into inst.
.\"

.H 2 "Installation Method"
.\"
.\" The installation methods are called "miniroot installation" and 
.\" "IRIX installation". The specific subsystems that require Miniroot
.\" Installation should be listed, or state that the product can be 
.\" installed with IRIX Installation.
.\"
.\" If some subsystems of this option must be installed using the miniroot
.\" and others can be installed using IRIX, fill in the table below:
.\"
.\" If all subsystems of this option can be installed using using IRIX, 
.\" include the following paragraph. Be sure to delete the comment
.\" marks at the beginning of each line so the paragraph will print.
.\"
All of the subsystems for the Disk Plexing Option can be installed using IRIX. You
do not need to use the miniroot.  Refer to the \f2IRIS Software
Installation Guide\f1 for complete installation instructions.
.\"
.H 2 "Prerequisites"
.\"
.\" Delete this section if it does not apply.
.\"
.\" Every prerequisite of every subsystem should be listed whether it's in
.\" spec file or not. Be sure to include specific release numbers when
.\" the prerequisite is a subsystem in a different product.  If there are
.\" many prerequisites, you might want to list them in a table. 
.\"
.\" Examples of prerequisite information are:
.\"
.\" If you want to install a.b.c, you must also install a.b.d.
.\" If you want to install a.b.c, release n.0 or later of x.y.z must be
.\" installed.
Your system must be running release IRIX 6.4 and have
XLV installed to use the Disk Plexing Option.
.\"
.\"
.\" Delete this section if it does not apply.
.\"
.\" If any of the subsystems in your product should not be simultaneously
.\" installed with other subsystems (in your product or not), or shouldn't
.\" be installed with particular releases of other subsystems, list these
.\" incompatibilities.
.\"

.\"
.\" Delete this section if it does not apply.
.\"
.\" List the configuration files in your product.  Tell what their purpose
.\" is and give users some idea of how and why they might want to modify them.
.\" You should also discuss each of the changes made in each of the 
.\" configuration files for this release to make the process of merging
.\" .fp 4 HD

.\" .H 2 "Files Not Listed by \f4versions\fP"
.\" .fp 4 PX
.\"
.\" Delete this section if it does not apply.
.\"
.\" If the product includes postops or exitops that create files, to the
.\" user these files are part of the product.  However, the versions
.\" command won't include these files in a file listing of your product.
.\" It would be nice to include a list of these files in the Release Notes
.\" because users have no other way of knowing that these files were created
.\" during installation, are part of your product, and shouldn't be removed.
.\"
.\" .H 2 "Other Installation Information"
.\"
.\" Delete this section if it does not apply.
.\"
.\" Any other installation issues for your product.
