.fp 1 PA
.fp 2 PI
.fp 3 PB
.fp 4 PX         
.fp 5 H
.fp 6 HB
.fp 7 C
.fp 8 CB
.nr H1 1
.H 1 "Installation Information"
.\"
.\"	Developer
.\"
This chapter provides information about installing
FDDIXPress software. 
The information listed here is product-specific;
for general information about installing software,
refer to the 
\f2Software Installation Administrator's Guide\fP
and
\f2Personal System Administration Guide.\f1
.P
.rs
.sp .05in
The FDDIXPress product consists of a hardware component 
and a software component. 
The hardware component is an FDDI board; the software
is on the CD-ROM.
To install the product, follow the procedures 
in the overview below. The procedures must be followed in the
order they are listed.
.AL
.LI
Install the software, using the instructions in this document in
Section 2.2, ``Installing FDDIXPress Software\f1.''
.LI
Configure the software, using the instructions in section 2.3,
``Configuring the FDDIXPress Software.''
.LI
Install the board, using the board's installation guide,
or have an authorized field service engineer install the
board using the field service installation instructions.
.LI
Configure your FDDI station's environment to be user-friendly, 
using the instructions in the section ``Configuring the Environment
for User-Friendliness and Safety,'' in Chapter 2 of 
the \f2FDDIXPress Administration Guide\f1.
.LI
Verify the FDDI connection, using the instructions in the section
``Verifying the FDDI Connection,'' in Chapter 2 of the
\f2FDDIXPress Administration Guide\f1.
.LE
.rs
.sp -.1i
.H 2 "General Installation Information"
This section contains general information about the FDDIXPress software.
This information is useful during installation and configuration.
.H 3 "FDDI Network Interface Names"
Each type of FDDIXPress board has its own
network interface software.
During development, each network interface is given a name.
The FDDI interface names that have been shipped
with this release are specified below:
.VL 9
.LI "\f2rns#\f1"
for O2, Origin, Onyx2, and OCTANE platforms.
The first FDDIXPress board found is assigned the name \f2rns0\f1.
The second board
is assigned the name \f2xpirns\f1, and so on.
.LI "\f2xpi#\f1"
for IRIS Indigo, Indigo\s-4\u2\d\s+4, CHALLENGE, and Onyx platforms.
The first FDDIXPress board found is assigned the name \f2xpi0\f1.
(or second port of dual-port boards such as those the FDDIXPHID)
On Indigo\s-4\u2\d\s+4 and CHALLENGE M machines, the system
searches for the FDDIXPress boards in the GIO option slots in the
following order: top slot first, middle slot second, bottom slot last.
.LI "\f2ipg#\f1"
for VMEbus systems, including CHALLENGE L,
and CHALLENGE XL.
The board's jumper-configured unit number determines 
the final number on 
the interface name 
(for example, \f2ipg0\f1, \f2ipg1\f1, \f2ipg2\f1, etc.). 
.LE
.rs
.sp -.1i
.H 3 "FDDIXPress Subsystems"
..\"
.\" Each subsystem should be described in enough detail so that
.\" users can decide whether or not they need to install it.
.\" Hints such as "You need to install this subsystem if you want to use
.\" Visual System Administration Tools" or "This subsystem is useful only
.\" if you want to display Kanji characters" would be nice. For subsystems
.\" such as eoe2.sw.4Dwm that are important if you have graphics, but not 
.\" important for servers and aren't marked required in the spec file (inst 
.\" doesn't show + and doesn't require their installation), be sure to make
.\" this very clear in the description or in a separate list.
.\"
Following is a description of the FDDIXPress subsystems:
.VL 30
.LI "\f2FDDIXPress.sw.FDDIXPress\f1"
FDDIXPress software: driver, utilities, SMT daemon, 
and miscellaneous files.
.LI "\f2FDDIXPress.man.FDDIXPress\f1"
Manual pages for FDDIXPress utilities and SMT daemon.
.LI "\f2FDDIXPress.man.relnotes\f1"
These release notes.
.LE
.rs
.sp +.05i

.H 3 "FDDIXPress Subsystem Disk Space Requirements"
.\"
.\" The size of each subsystem should be listed so that users get an idea
.\" of the disk space requirements before they get into inst.
.\"
This section lists the FDDIXPress subsystems and their sizes.
All these subsystems are installed
when you use the \f7\s-1install FDDIXPress \s+1\f1 and \f7\s-1go\s+1\f1 
commands of \f2inst\f1.
.rs
.sp +.01i 
.VL 7
.LI "\f6Note:\f1"
The listed subsystem sizes are approximate. 
Refer to the 
\f2Software Installation Administrator's Guide\f1
for information on determining exact sizes.
.LE
.rs
.sp +.01i
.ps 9
.vs 11
.TS
tab(:);
lw(1.75i):lw(1.5i)
lw(1.75i):lw(1.5i)
lIw(1.75i):nw(1.5i).
\f6Subsystem Name:Subsystem Size
:\f6(512-byte blocks)\f1
.ps 10
.vs 12
.sp 0.3
FDDIXPress.sw.FDDIXPress:\f12163
.br
.sp 0.3
FDDIXPress.man.FDDIXPress:\f139
.br
.sp 0.3
FDDIXPress.man.relnotes:\f140
.br
.TE
.H 3 "Installation Method"
All of the subsystems for FDDIXPress can be installed using the 
IRIX\(tm installation method.
You do not need to use the miniroot, although you may do so, if convenient
as part of an operating system upgrade. 
Refer to the
\f2Software Installation Administrator's Guide\fP or the
installation instructions in the \f2Personal System Administration Guide\f1
for complete installation instructions.
.VL 7
.LI "\f6Note:\f1"
The FDDIXPress driver will not function until three additional steps are
completed: (1) the board is installed, (2) the operating system 
is rebuilt, by restarting the system or using the \f2autoconfig\f1
command, and (3) the system is rebooted.
.LE
.rs
.sp +.01in
.H 3 "Configuration Files"
The files listed below are used by FDDIXPress software.
Editing these files is rarely required.
.P
.br
.nf
.ta 2in 
\f2/etc/fddi/smtd.conf\fP	SMT daemon configuration file.
.br
	Experienced FDDI system administrators
.br
	may want to edit this file.
.P
.ta 2in
.br
\f2/etc/fddi/smtd.mib\fP	Management Information Base file.
.br
	This file should never be edited.
.P
.ta 2in
\f2/var/sysgen/master.d/if_ipg\f1	IPG driver configuration file.
.br
	File for enabling/disabling a number of
.br
	\f2ipg\f1 driver flags.
.P
.ta 2in
\f2/var/sysgen/master.d/if_xpi\f1	XPI driver configuration file.
.br
	File for enabling/disabling a number of
.br
	\f2xpi\f1 driver flags.
.fi
.ta 2in
\f2/var/sysgen/master.d/if_rns\f1	RNS driver configuration file.
.br
	File for enabling/disabling a number of
.br
	\f2rns\f1 driver flags.
.fi
.H 2 "Installing FDDIXPress Software"
This section describes how to install FDDIXPress
software.
.P
Before starting the installation, use the command
below to verify that FDDIXPress
is not already installed. For example, FDDIXPress
may have been installed at the same time as the operating system.
.rs
.nf
.sp
\f7\s-1% \f8versions FDDIXPress\s+1\f1
.fi
.sp
If the display indicates that FDDIXPress 6.5 is installed, you
can skip the software installation procedure and
proceed to the configuration.
Otherwise, follow the instructions below to install FDDIXPress.
.rs
.sp +.02i
.H 3 "Prerequisites"
Your system must be running IRIX release 6.5.
To verify the release your system is currently running, use
the command below:
.rs
.nf
.sp
\f7\s-1% \f8versions eoe
.br
\f7I eoe   \f2date\f7   IRIX Execution Environment, 6.5
\s+1\f1
.fi
.sp .03i
.H 3 "Preparing for Installation"
.\" begin a numbered list
.AL
.LI
Determine the installation method.
.P
There are four methods for installing the FDDIXPress software: from a local 
peripheral device, from a remote peripheral device, 
from a remote Ethernet boot server (distribution directory), from
a local distribution directory. These methods are summarized and
explained in Chapter 4 of the \f2IRIS Software Installation Guide\f1, where
Table 4-1 provides an excellent overview. 
.VL 7
.LI "\f6Note:\f1"
``Local'' refers to connecting the CD-ROM (or tape) player 
directly to the target system 
(the system onto which you are installing software). 
``Remote'' refers to loading the 
software over the target system's Ethernet network connection using a
CD-ROM (or tape) device connected to a different Ethernet station.
.LE
.rs
.sp
In order to install FDDIXPress software from a remote distribution directory, 
your system must be physically connected to the Ethernet and it 
must have a functioning Ethernet connection.
.LI
Locate the following items:
.P
.\" begin a nested, bullet list
.VL 5 
.LI -
For installation from a peripheral device, locate
the CD-ROM disk containing FDDIXPress software. 
If you specially ordered another 
medium (for example, tape), locate that item. 
.LI -
For installation from a peripheral device, locate
a device to play (read) the CD-ROM or tape. 
This device is not shipped with the 
FDDIXPress product; it belongs to your site.
.LI -
For installation from a distribution directory, determine the host name 
of the Ethernet station and the path to the directory.
.LE
.\" end nested bullet list
.LI
Set up the installation hardware.
.VL 5
.LI -
If you are using a local device, follow the instructions in your 
system's owner's guide to connect the peripheral device.
.LI -
If you are using a remote device, follow the remote workstation or server's 
instructions for attaching peripheral devices.
.LI -
For installation from a distribution directory,
verify that FDDIXPress has been
loaded onto the station.
A section of the
\f2IRIS Software Installation Guide\f1 provides instructions on 
preparing distribution directories.
.LE
.\" end of nested, bullet list
.LE
.\" end numbered list
.rs
.H 3 "Installing the Software"
Use the IRIX installation method to 
install the FDDIXPress software.
Step-by-step instructions are provided below.
.VL 7
.LI "\f6Note:\f1"
More detailed explanations about the IRIX installation method
are located  
in the 
\f2Software Installation Administrator's Guide\f1
and the \f2Personal System Administration Guide\f1.
.\"\f2IRIS Software Installation Guide\f1. 
.\"Section 4.7.6 may be especially useful.
.\"If you are not sure how to use \f2inst\f1, 
.\"Chapter 5 in the 
.\"\f2IRIS Software Installation Guide\f1 provides details.
.LE 
.\" end of note
.AL
.LI
In a shell window, become superuser:
.sp +.04in
\s-1\f7% \f8su
.br
\f7Password: \f2thepassword\f1
.br
\f7#\f1\s+1
.LI
Invoke the \f2inst\f1 utility with the command below:
.sp +.04in
\s-1\f7# \f8inst\f1
.br
 \f1{the \f2inst\f1 menu appears}
.br
\f7Inst> \f1\s+1
.LI
When the \f2inst\f1 prompt appears (\f7Inst>\f1),
use the \f7\s-1from \s+1\f1 command
to indicate the location of FDDIXPress software.
Table 10-2 in the \f2IRIS Software Installation Guide\f1 summarizes the 
entries for this command.
.P
The command below can be used when 
the location is a local CD-ROM:
.sp +.04in
\s-1\f7Inst> \f8from /CDROM/dist\f1\s+1
.LI 
When you are ready to install FDDIXPress, 
use the command below to prepare for installation:
.sp +.04in
\s-1\f7Inst> \f8install FDDIXPress\f1\s+1
.LI
Then use the command below to install the software:
.sp +.04in
\s-1\f7Inst> \f8go\f1\s+1
.LI
When the installation completes successfully, quit:
.sp +.04in
\s-1\f7Inst> \f8quit\f1\s+1
.LI
Follow the steps in Section 2.3, ``Configuring the FDDIXPress Software.''
.LE
.rs
.sp
.H 2 "Configuring the FDDIXPress Software"
This section describes the quickest, easiest method
to configure a new FDDI network connection for the scenarios
in the bulleted list below. If your system has a configuration
that is not covered,
follow the instructions in the \f2FDDIXPress Administration
Guide\f1. 
.P
It is highly recommended that the FDDIXPress
configuration procedure be done before 
installing the FDDIXPress board. If you install the board and restart
the system without configuring the FDDIXPress software, the
FDDI connection will not function when the system comes up. 
If the system also has an
Ethernet connection, the Ethernet will not function either.
.VL 7
.LI "\f6Note:\f1"
The instructions in this section assume that the system
already has (or has had) a functional Ethernet connection.
If this is not the case, follow the instructions in the 
\f2Personal System Administration Guide\f1 or the 
\f2Advanced Site and Server Administration Guide\f1 to configure
the system for networking (giving it a host name, IP address,
etc.).
.LE
.P
This section is divided into three configuration scenarios.
Select the one that is appropriate.
.BL
.LI
FDDI as the primary network interface with Ethernet as the secondary.
.br
This configuration is recommended for stations 
with two network connections and a disk.
.LI
FDDI as the secondary network interface with Ethernet as the primary.
.br
This configuration is recommended for a diskless workstation.
.LI
FDDI as the only network connection.
.LE
.rs
.VL 7
.LI "\f6Note:\f1"
The procedures described in the following sections configure a basic
non-personalized FDDI network connection. If you need
or want to configure site-specific items, follow
the instructions in Chapter 2 of the \f2FDDIXPress
Administration Guide\f1, either now (instead of the
instructions provided here) or after 
you have used the instructions here to get the system up and running.
.LE 
.rs
.sp
.ns
.H 4 "Configuring FDDI as Primary and Ethernet as Secondary"
This section provides instructions to set up your system so the 
FDDI connection serves as the primary network interface and
Ethernet is the secondary network interface. This
configuration is the easiest to do and provides the best 
performance.
.VL 7
.LI "\f6Note:\f1"
If your site uses an NIS service, the changes to the 
\f2/etc/hosts\f1 file described in this section must
also be made to the hosts database on the NIS server.
.LE
.AL
.LI
If you are not superuser, type \f8\s-1su \s+1\f1 
to become superuser (\f2root\f1):
.sp +.04in
\s-1\f7% \f8su\f1
.br
\f7Password: \f2thepassword\f1
.br
\f7#\f1\s+1
.LI
Determine your station's host name:
.sp +.04in
\s-1\f7# \f8hostname\f1\s+1
.LI
Use your favorite editor to open the \f2/etc/hosts\f1 file.
To open the file with \f2jot\f1, use the line below:
.sp +.04in
\s-1\f7# \f8/usr/sbin/jot /etc/hosts\s+1\f1 
.LI
Find the line with your station's host name. 
.LI
Copy this line. Paste the copy below the original.
.LI
Return to the original line. Change the address (digits on the left)
to the IP address for the FDDI network. 
This line configures your station's FDDI 
network interface. Do not change the host name.
.VL 7
.LI "\f6Note: \f1
IP addresses are usually assigned by a site's
network administrator (who has obtained the addresses from
the Network Information Center). The network portion of the
IP address for each local area network must be unique;
you cannot use the same network address for your system's
Ethernet and FDDI connections. For further information, see the
section on choosing an IP address in the
\f2IRIX Advanced Site and Server Administration Guide\f1.
.LE
.LI
Go to the new line. Change each instance of your station's \f2hostname\f1 
to ``gate-\f2hostname\f1''.
This line configures your station's Ethernet network interface.
.VL 7 
.LI "\f6Note:\f1"
Do not change the IP address on the new line (representing the
Ethernet connection.)
.LE
.P
For example, if you were creating entries for a station with
a host name of \f2mickey\f1 residing in the domain \f2disney.com\f1, 
you would now have the following
two lines in the \f2/etc/hosts\f1 file, where each x can be one
to three digits:
.nf
.ta .7in 2.3in 3.25in
.P
\f7\s-2x.x.x.x	mickey.disney.com	mickey	#FDDI primary
x.x.x.x	gate-mickey.disney.com	gate-mickey	#Ether secondary\s+2\f1
.fi
.LI
Save and close the file.
.LI
The system is now ready to have its FDDIXPress board installed.
Either follow the instructions
in the FDDIXPress board's installation guide to install the board, or
have an authorized field service engineer install the board
using the field service installation instructions.
.VL 7
.LI "\f6Note:\f1"
If the board is already installed, restart the system, rebuild the
operating system by answering \f8\s-1yes \f1\s+1when prompted, then restart 
the system a second time.
.LE
.LE
.rs
.ns
.H 4 "Configuring FDDI as Secondary and Ethernet as Primary"
This section provides instructions to configure your system so the 
FDDI connection serves as the secondary network interface and 
Ethernet is the primary one. This configuration is recommended for
diskless workstations.
.sp
When FDDI is the secondary interface, the
system does not make the most efficient use of the FDDI connection.
For workstations with disks, it is recommended that the 
FDDI network interface be configured as 
the primary interface.
.AL
.LI
If you are not superuser, become superuser (\f2root\f1):
.sp +.04in
\s-1\f7% \f8su\f1
.br
\f7Password: \f2thepassword\f1
.br
\f7#\s+1\f1
.LI
Determine your station's host name.
.sp +.04in
\s-1\f7# \f8hostname\f1\s+1
.LI
Use your favorite editor to open the \f2/etc/hosts\f1 file.
To open the file with \f2jot\f1, use the command below:
.sp +.04in
\s-1\f7# \f8/usr/sbin/jot /etc/hosts\s+1\f1 
.LI
Find the line with your station's host name. This line configures your
station's Ethernet network interface.
.LI
Copy this line. Paste the copy below the original. This new line configures
your station's FDDI network interface.
.LI
On the new line, change each instance of your station's \f2hostname\f1  
to ``fddi-\f2hostname\f1''.
.LI
On the same line, change the address (digits on the left) 
to the FDDI IP address.
.VL 7
.LI "\f6Note: \f1
IP addresses are usually assigned by a site's
network administrator (who has obtained the addresses from
the Network Information Center). The network portion of the
IP address for each local area network must be unique;
you cannot use the same network address for your system's
Ethernet and FDDI connections. For further information, see the
section on choosing an IP address in the
\f2IRIX Advanced Site and Server Administration Guide\f1.
.LE
.P
For example, if you were creating entries for a station with
a host name of \f2minnie\f1 residing in the domain \f2disney.com\f1, 
you would have the 
following
two lines in the \f2/etc/hosts\f1 file, where each x can be one
to three digits:
.nf
.ta .7in 2.3in 3.25in
.P
\f7\s-2x.x.x.x	minnie.disney.com	minnie	#Ether primary
x.x.x.x	fddi-minnie.disney.com	fddi-minnie	#FDDI secondary\s+2\f1
.fi
.LI
Save and close the file.
.LI
Open the \f2/etc/config/netif.options\f1 file.
To open the file with \f2jot\f1, use the command line below:
.sp +.04in
\s-1\f7# \f8/usr/sbin/jot /etc/config/netif.options\s+1\f1 
.LI
Find the line below:
.sp +.04in
\f7\s-1: if1name=\s+1\f1
.LI
Change the line to one of the following entries. 
Notice that the colon and leading space must be removed,
and the name of the Ethernet interface must be the name of the 
interface currently
installed on the station (for example, \f2ec0\f1 is 
the built-in Ethernet interface
for Indigo\s-4\u2\d\s+4, and IRIS Indigo).
.sp +.04in
\f8\s-1if1name=ec0\s+1\f1
.br
or
.br
\f8\s-1if1name=\f2Ethernetinterface\s+1\f1
.LI
Find the line below:
.sp +.04in
\f7\s-1: if2name=\s+1\f1
.LI
Edit the line to match one of the following lines.
Notice that the colon and leading space must be removed, and
the name of the FDDI interface must be correct
for the platform (for example, \f2rns0\f1 for O2, Origin, Onyx2, and OCTANE
systems).
.sp +.04in
\f8\s-1if2name=rns0\s+1\f1
.br
or
.br
\f8\s-1if2name=xpi0\s+1\f1
or
.br
\f8\s-1if2name=ipg0\s+1\f1
.LI
Find the line below:
.sp +.04in
\f7\s-1: if2addr=gate-$HOSTNAME\s+1\f1
.LI
Edit the line to read as follows. 
Notice that the colon and leading space must be removed.
.sp +.04in
\f8\s-1if2addr=fddi-$HOSTNAME\s+1\f1
.LI
Save and close the file.
.LI
The system is now ready to have its FDDIXPress board installed.
Either follow the instructions in the board's installation guide
to install the board, or have an authorized field service
engineer install the board, using the field service installation
instructions.
.VL 7
.LI "\f6Note:\f1"
If the board is already installed, restart the system, rebuild the
operating system by answering \f8\s-1yes \f1\s+1when prompted, then restart
the system a second time.
.LE
.LE
.rs
.sp
.ns
.H 4 "Configuring FDDI as the Only Network Interface" 
This section provides instructions to set up your system with one
network connection, an
FDDI connection.
.AL
.LI
If you are not superuser, use the command below to 
become superuser (\f2root\f1).
.sp +.04in
\s-1\f7% \f8su
.br
\f7Password: \f2thepassword\f1
.br
\f7#\s+1\f1
.LI
Determine your station's host name, using the command below:
.sp +.04in
\s-1\f7# \f8hostname\f1\s+1
.LI
Use your favorite editor to open the \f2/etc/hosts\f1 file.
To open the file with \f2jot\f1, use the command below:
.sp +.04in
\s-1\f7# \f8/usr/sbin/jot /etc/hosts\f1\s+1
.LI
Find the line with your station's host name. 
.LI
Change the address (digits on the left)
to the IP address for the FDDI network.
.P
For example, if you were making an entry for a station with
a host name of \f2mickey\f1 residing in the domain \f2disney.com\f1
with an FDDI IP address of 187.8.27.6, 
you would have created the following
line in the \f2/etc/hosts\f1 file:
.nf
.ta .8in 2.3in 3.25in
.P
\f7\s-2187.8.27.6	mickey.disney.com	mickey	#FDDI\s+2\f1
.fi
.LI
Save and close the file.
.LI
The system is now ready to have its FDDXPress board installed.
Either follow the instructions in the board's installation guide to
install the board, or have an authorized field service engineer
install the board, using the field service installation instructions.
.VL 7
.LI "\f6Note:\f1"
If the board is already installed, restart the system, rebuild
the operating system by answering \s-1\f8yes \f1\s+1when prompted,
then restart the system a second time.
.LE
.LE
.rs
.sp
.ns
.H 2 "Configuring a Diskless Station"
A diskless FDDI station must be configured in accord with the guidelines
in this section.
.AL
.LI
The station must have either two network interfaces
(an Ethernet from which to boot and an FDDI)
or a local CD-ROM player from which to boot and an FDDI interface.
The remaining text and guidelines apply only to stations that boot
over an Ethernet.
.P
A diskless workstation (client) must boot (from its server) over
its Ethernet connection,
hence, the diskless station must have both
Ethernet and
FDDI connections, if it wants to use resources on an FDDI network.
Use the command below to display the station's network interfaces, then
verify that one of the IP addresses in the display is for an Ethernet and
one is for an FDDI local area network:
.rs
.sp +.03i
\s-1\f7% \f8/usr/etc/netstat -in
.Ee
.LI
The \f2netaddr\f1 value in NVRAM must be an Ethernet IP address.
.P
The station's PROM must use the  
Ethernet connection
for booting over the network. 
To verify that the system's PROM can access the Ethernet, 
use the commands below.
The output from \f2netaddr\f1 and the \f2inet\f1 value must match.
.sp +.03i
\s-1\f7% \f8/etc/nvram netaddr
.br
\f2xxx.xxx.xxx.xxx
.br
\f7% \f8/usr/etc/ifconfig  \f2Ethernetinterface\f7
.br
 . . .
.br
    inet \f2xxx.xxx.xxx.xxx  . . .\f1
.Ee
.LI
Ethernet must be configured as the primary network interface.
.P
Once the PROM has loaded the miniroot (bootstrap kernel) from the boot server,
control is passed to the miniroot. 
At this point, the diskless client is known to the
boot server by the IP address in the NVRAM. 
If this address were to change at this point,
the server would become confused and the boot process would not complete. 
The best and easiest way to prevent this from happening 
is to configure Ethernet 
(and build the miniroot with Ethernet)
as the primary network interface.
.P
To verify that Ethernet is configured as the primary network interface
and FDDI is the secondary, use the commands below,
where \f2Ethernetinterface\f1 is ec0, enp0, et0, ef0
or another Ethernet interface and \f2FDDIinterface\f1 is rns\f2#\f1
.\" ipg\f2#\f1 or xpi\f2#\f1:
.rs
.sp +.03i
\s-1\f7# \f8/bin/grep if1name /etc/config/netif.options\f1\s+1
.br
\&...
.br
\f7if1name=\s-1\f2Ethernetinterface\s+1\f1
.br
\s-1\f7# \f8/bin/grep if2name /etc/config/netif.options\f1\s+1
.br
\&...
.br
\f7if2name=\s-1\f2FDDIinterface\s+1\f1
.Ee
.LE
.VL 7 
.LI "\f6Note:\f1"
Once the miniroot is in control, the booting procedure is
completed using NFS\(rg over the network interface that the
station's route daemon indicates is the shortest path to the boot server.
If you want booting to complete over the FDDI network, use a \f2route\f1
command in a configuration file to force the route daemon (\f2routed\f1) 
to believe that the shortest route
to the boot server is over the FDDI network interface.
See the man pages for \f2routed\f1(1M) and \f2route\f1(1M) for details.
.LE
